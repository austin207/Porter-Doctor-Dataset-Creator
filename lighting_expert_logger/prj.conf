## CMakeLists.txt
```
cmake_minimum_required(VERSION 3.20.0)

find_package(Zephyr REQUIRED HINTS $ENV{ZEPHYR_BASE})

project(lighting_expert_logger)

target_sources(app PRIVATE src/main.c)
```

## prj.conf
```kconfig
# Zephyr config for lighting_expert_logger

CONFIG_SERIAL=y
CONFIG_CONSOLE=y
CONFIG_UART_CONSOLE=y
CONFIG_LOG=y
CONFIG_PRINTK=y

CONFIG_GPIO=y
CONFIG_I2C=y
CONFIG_SPI=y
CONFIG_ADC=y
CONFIG_SENSOR=y

CONFIG_DISK_ACCESS=y
CONFIG_FILE_SYSTEM=y
CONFIG_FAT_FILESYSTEM_ELM=y
CONFIG_FS_FATFS=y
CONFIG_SDMMC_STACK=y

CONFIG_MAIN_STACK_SIZE=4096
CONFIG_HEAP_MEM_POOL_SIZE=8192

CONFIG_NEWLIB_LIBC=y
CONFIG_MINIMAL_LIBC=n
```

## boards/esp32_devkit.overlay
```dts
/* Board overlay placeholder for Lighting Expert Logger. */
/* Add final pin mapping after hardware is selected. */
```

## src/main.c
```c
#include <zephyr/kernel.h>
#include <zephyr/sys/printk.h>

int main(void)
{
    printk("========================================\n");
    printk("Lighting Expert Logger\n");
    printk("========================================\n");
    printk("Collects lighting-system telemetry for LED, driver and brightness mismatch fault detection.\n");
    printk("Skeleton generated.\n");

    while (1) {
        k_sleep(K_SECONDS(1));
    }

    return 0;
}
```
